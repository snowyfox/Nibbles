## firmware/base/main/Kconfig.projbuild
```kconfig
menu "Nibbles base"

    choice NIBBLES_POWER_SIM
        prompt "Simulated power board data"
        default NIBBLES_POWER_SIM_OFF
        help
            Made-up power board readings, used as if they were real: the screen and
            the log (marked 2 in its sim column), and the charge graph refills from
            them after a restart. They never go to WLED: NL_MSG_BATTERY would change
            its current limit on real LEDs. If a real power board answers, the base
            drops the simulation until it's restarted. Keep this off in a festival
            build: a dead board would look like a healthy one.

        config NIBBLES_POWER_SIM_OFF
            bool "Off: real readings only"
        config NIBBLES_POWER_SIM_REALISTIC
            bool "Realistic: festival nights in real time (hours)"
        config NIBBLES_POWER_SIM_FAST
            bool "Fast: every value and problem in about 2 minutes"
    endchoice

endmenu
```
